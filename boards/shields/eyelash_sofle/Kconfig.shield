## boards/shields/eyelash_sofle/Kconfig.shield
```kconfig
# Copyright (c) 2020 The ZMK Contributors
# Copyright (c) 2025 Jacky-Lzx
# SPDX-License-Identifier: MIT

config SHIELD_EYELASH_SOFLE_CENTRAL_DONGLE
    def_bool $(shields_list_contains,eyelash_sofle_central_dongle)

config SHIELD_EYELASH_SOFLE_PERIPHERAL_LEFT
    def_bool $(shields_list_contains,eyelash_sofle_peripheral_left)

config SHIELD_EYELASH_SOFLE_PERIPHERAL_RIGHT
    def_bool $(shields_list_contains,eyelash_sofle_peripheral_right)
```

## config/west.yml
```yaml
manifest:
    remotes:
        - name: zmkfirmware
          url-base: https://github.com/zmkfirmware
        - name: gpeye
          url-base: https://github.com/GPeye
        - name: tokyo2006
          url-base: https://github.com/tokyo2006
        - name: englmaxi
          url-base: https://github.com/englmaxi
        - name: jackylzx
          url-base: https://github.com/Jacky-Lzx
    projects:
        - name: mario-peripheral-animation
          remote: gpeye
          revision: main
        - name: zmk
          remote: zmkfirmware
          revision: v0.3.0
          import: app/west.yml
        - name: prospector-zmk-module # <--- and these
          remote: tokyo2006 # <---
          revision: micro_spi2
        - name: keyboard.nice_view_module # nice-view-module
          remote: jackylzx
          revision: main
        - name: zmk-dongle-display
          remote: englmaxi
          revision: v0.3
    self:
        path: config
```
